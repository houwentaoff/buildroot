## defconfig
```kconfig
BR2_arm=y
BR2_KERNEL_HEADERS_3_2=y
BR2_TOOLCHAIN_BUILDROOT_GLIBC=y
BR2_TOOLCHAIN_BUILDROOT_CXX=y
BR2_PACKAGE_HOST_GDB=y
BR2_PACKAGE_HOST_GDB_TUI=y
BR2_PACKAGE_HOST_GDB_PYTHON=y
BR2_PACKAGE_GDB=y
BR2_PACKAGE_PYTHON=y
BR2_PACKAGE_PYTHON_SSL=y
BR2_PACKAGE_PYTHON_HASHLIB=y
BR2_PACKAGE_PYTHON_PYCURL=y
BR2_PACKAGE_PYTHON_SETUPTOOLS=y
BR2_PACKAGE_PYTHON_UJSON=y
BR2_PACKAGE_PYTHON_URLLIB3=y
BR2_PACKAGE_GNUTLS_TOOLS=y
BR2_PACKAGE_SQLITE=y
BR2_PACKAGE_SQLITE_STAT3=y
BR2_PACKAGE_SQLITE_ENABLE_FTS3=y
BR2_PACKAGE_SQLITE_ENABLE_UNLOCK_NOTIFY=y
BR2_PACKAGE_SQLITE_SECURE_DELETE=y
BR2_PACKAGE_JSON_C=y
BR2_PACKAGE_JSONCPP=y
BR2_PACKAGE_LIBJSON=y
BR2_PACKAGE_WIRELESS_TOOLS=y
BR2_PACKAGE_WIRELESS_TOOLS_LIB=y
BR2_PACKAGE_WPA_SUPPLICANT=y
BR2_PACKAGE_WPA_SUPPLICANT_AP_SUPPORT=y
BR2_PACKAGE_WPA_SUPPLICANT_WPS=y
BR2_PACKAGE_WPA_SUPPLICANT_WPA_CLIENT_SO=y
```

## package/python-pycurl/Config.in
```kconfig
config BR2_PACKAGE_PYTHON_PYCURL
        bool "python-pycurl"
        select BR2_PACKAGE_GNUTLS
        select BR2_PACKAGE_LIBCURL 
##        select BR2_PACKAGE_OPENSSL
        help
          pycurl is a collection of curl algorithms and
          protocols, implemented for use from Python.

          http://foosoftware.org/libfoo/
```
